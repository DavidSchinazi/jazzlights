#include "jazzlights/network/ota_handler.h"

#if JL_OTA

#include <esp_app_desc.h>
#include <esp_chip_info.h>
#include <esp_system.h>
#include <freertos/FreeRTOS.h>
#include <freertos/task.h>
#include <string.h>

#include <algorithm>
#include <cinttypes>

// Generated by extras/scripts/software_version.py. It's only included here so that a new version only recompiles this.
#include "generated_software_version.h"
#include "jazzlights/network/tlv.h"
#include "jazzlights/util/log.h"

namespace jazzlights {
namespace {

enum OTAType : uint64_t {
  kOtaQuery = 3,
  kOtaInfo = 4,
  kOtaBegin = 5,
  kOtaData = 6,
  kOtaAck = 7,
  kOtaEnd = 8,
  kOtaResult = 9,
};

enum OTAStatus : uint64_t {
  kOtaStatusSuccess = 0,
  kOtaStatusNoPartition = 1,
  kOtaStatusBadImageSize = 2,
  kOtaStatusWrongChip = 3,
  kOtaStatusAlreadyUpdating = 4,
  kOtaStatusBeginFailed = 5,  // This includes when the running firmware hasn't been marked valid yet.
  kOtaStatusNotUpdating = 6,
  kOtaStatusWriteFailed = 7,
  kOtaStatusSha256Mismatch = 8,
  kOtaStatusImageInvalid = 9,  // esp_ota_end() failed.
  kOtaStatusWrongProject = 10,
  kOtaStatusSetBootFailed = 11,
};

constexpr uint8_t kSoftwareVersion[] = {JL_SOFTWARE_VERSION_BYTES};
static_assert(sizeof(kSoftwareVersion) == 20 || sizeof(kSoftwareVersion) == 52);
constexpr char kBuildEnvironment[] = JL_BUILD_ENVIRONMENT;
constexpr uint64_t kBuildTime = JL_BUILD_TIME;
static_assert(kBuildTime <= kMaxVarint);
constexpr size_t kSha256Size = 32;
// Rolling back writes to flash then reboots, which is all this task does. It only exists until the firmware is
// confirmed.
constexpr uint32_t kRollbackTaskStackSize = 4096;
constexpr UBaseType_t kRollbackTaskPriority = tskIDLE_PRIORITY + 1;
constexpr BaseType_t kRollbackTaskCore = 0;

uint64_t ChipModel() {
  esp_chip_info_t chipInfo;
  esp_chip_info(&chipInfo);
  return static_cast<uint64_t>(chipInfo.model);
}

}  // namespace

void OTAHandler::OnTLV(SecureSession& session, uint64_t type, const uint8_t* value, size_t length) {
  switch (type) {
    case kOtaQuery:
    case kOtaEnd:
      // These have no fields yet, but they're still containers that must be well formed.
      if (!ParseTLVFields(value, length, nullptr, 0)) {
        session.Close(kSecureChannelStatusMalformed);
      } else if (type == kOtaQuery) {
        HandleQuery(session);
      } else {
        HandleEnd(session);
      }
      break;
    case kOtaBegin: HandleBegin(session, value, length); break;
    case kOtaData: HandleData(session, value, length); break;
    default: break;  // These other types only go from server to client.
  }
}

void OTAHandler::OnSessionEnd(SecureSession& session, bool /*clean*/) {
  if (updating_ != &session) { return; }
  jll_info("OTA aborting update because its session ended");
  AbortUpdate();
}

void OTAHandler::HandleQuery(SecureSession& session) {
  const esp_partition_t* partition = esp_ota_get_next_update_partition(nullptr);
  uint8_t info[128];
  TLVWriter writer(info, sizeof(info));
  writer.WriteInteger(0, partition != nullptr ? partition->size : 0);
  writer.WriteBytes(1, kSoftwareVersion, sizeof(kSoftwareVersion));
  writer.WriteInteger(2, ChipModel());
  writer.WriteBytes(3, reinterpret_cast<const uint8_t*>(kBuildEnvironment), sizeof(kBuildEnvironment) - 1);
  writer.WriteBytes(4, localDeviceId_.data(), NetworkDeviceId::size());
  writer.WriteInteger(5, kBuildTime);
  if (writer.failed()) { jll_fatal("OTA failed to write OtaInfo"); }
  session.Send(kOtaInfo, info, writer.size());
}

void OTAHandler::HandleBegin(SecureSession& session, const uint8_t* value, size_t length) {
  TLVField fields[] = {
      {0, TLVField::Kind::kInteger, /*required=*/true},
      {1, TLVField::Kind::kBytes, /*required=*/true, kSha256Size},
      {2, TLVField::Kind::kInteger, /*required=*/true},
      {3, TLVField::Kind::kFlag, /*required=*/false},
  };
  if (!ParseTLVFields(value, length, fields, sizeof(fields) / sizeof(fields[0]))) {
    session.Close(kSecureChannelStatusMalformed);
    return;
  }
  const esp_partition_t* partition = esp_ota_get_next_update_partition(nullptr);
  if (partition == nullptr) {
    SendResult(session, kOtaStatusNoPartition);
    return;
  }
  if (fields[0].integer == 0 || fields[0].integer > partition->size) {
    SendResult(session, kOtaStatusBadImageSize);
    return;
  }
  if (fields[2].integer != ChipModel()) {
    SendResult(session, kOtaStatusWrongChip);
    return;
  }
  if (updating_ != nullptr) {
    SendResult(session, kOtaStatusAlreadyUpdating);
    return;
  }
  const esp_err_t err = esp_ota_begin(partition, OTA_WITH_SEQUENTIAL_WRITES, &handle_);
  if (err != ESP_OK) {
    jll_error("OTA esp_ota_begin failed with error %s", esp_err_to_name(err));
    SendResult(session, kOtaStatusBeginFailed);
    return;
  }
  mbedtls_sha256_init(&sha256_);
  mbedtls_sha256_starts(&sha256_, /*is224=*/0);
  updating_ = &session;
  partition_ = partition;
  imageSize_ = fields[0].integer;
  bytesWritten_ = 0;
  memcpy(imageSha256_, fields[1].value, kSha256Size);
  rebootWhenDone_ = fields[3].present;
  jll_info("OTA starting update of %" PRIu64 " bytes", imageSize_);
  SendAck(session, 0);
}

void OTAHandler::HandleData(SecureSession& session, const uint8_t* value, size_t length) {
  if (updating_ != &session) { return; }
  if (length > imageSize_ - bytesWritten_) {
    jll_error("OTA got more data than the image size");
    FailUpdate(kOtaStatusBadImageSize);
    return;
  }
  const esp_err_t err = esp_ota_write(handle_, value, length);
  if (err != ESP_OK) {
    jll_error("OTA esp_ota_write failed with error %s", esp_err_to_name(err));
    FailUpdate(kOtaStatusWriteFailed);
    return;
  }
  mbedtls_sha256_update(&sha256_, value, length);
  bytesWritten_ += length;
  SendAck(session, bytesWritten_);
}

void OTAHandler::HandleEnd(SecureSession& session) {
  if (updating_ != &session) {
    SendResult(session, kOtaStatusNotUpdating);
    return;
  }
  if (bytesWritten_ != imageSize_) {
    jll_error("OTA got %" PRIu64 " bytes out of %" PRIu64, bytesWritten_, imageSize_);
    FailUpdate(kOtaStatusBadImageSize);
    return;
  }
  uint8_t sha256[kSha256Size];
  mbedtls_sha256_finish(&sha256_, sha256);
  if (memcmp(sha256, imageSha256_, kSha256Size) != 0) {
    jll_error("OTA image doesn't have the expected SHA-256");
    FailUpdate(kOtaStatusSha256Mismatch);
    return;
  }
  // This validates the image, including its chip, and frees the handle whether it succeeds or not.
  esp_err_t err = esp_ota_end(handle_);
  const esp_partition_t* partition = partition_;
  const bool rebootWhenDone = rebootWhenDone_;
  StopUpdate();
  if (err != ESP_OK) {
    jll_error("OTA esp_ota_end failed with error %s", esp_err_to_name(err));
    SendResult(session, kOtaStatusImageInvalid);
    return;
  }
  esp_app_desc_t newDescription;
  err = esp_ota_get_partition_description(partition, &newDescription);
  const esp_app_desc_t* runningDescription = esp_app_get_description();
  if (err != ESP_OK || strncmp(newDescription.project_name, runningDescription->project_name,
                               sizeof(newDescription.project_name)) != 0) {
    jll_error("OTA image isn't for project %s", runningDescription->project_name);
    SendResult(session, kOtaStatusWrongProject);
    return;
  }
  err = esp_ota_set_boot_partition(partition);
  if (err != ESP_OK) {
    jll_error("OTA esp_ota_set_boot_partition failed with error %s", esp_err_to_name(err));
    SendResult(session, kOtaStatusSetBootFailed);
    return;
  }
  jll_info("OTA update succeeded");
  SendResult(session, kOtaStatusSuccess);
  if (rebootWhenDone) {
    jll_info("OTA rebooting into new firmware");
    server_->CloseAllSessionsAndFlush();
    esp_restart();
  }
}

void OTAHandler::SendAck(SecureSession& session, uint64_t bytesWritten) {
  uint8_t ack[VarintSize(0) + VarintSize(kMaxVarintSize) + kMaxVarintSize];
  TLVWriter writer(ack, sizeof(ack));
  writer.WriteInteger(0, bytesWritten);
  session.Send(kOtaAck, ack, writer.size());
}

void OTAHandler::SendResult(SecureSession& session, uint64_t status) {
  uint8_t result[VarintSize(0) + VarintSize(kMaxVarintSize) + kMaxVarintSize];
  TLVWriter writer(result, sizeof(result));
  writer.WriteInteger(0, status);
  session.Send(kOtaResult, result, writer.size());
}

void OTAHandler::StopUpdate() {
  mbedtls_sha256_free(&sha256_);
  updating_ = nullptr;
  partition_ = nullptr;
}

void OTAHandler::AbortUpdate() {
  esp_ota_abort(handle_);
  StopUpdate();
}

void OTAHandler::FailUpdate(uint64_t status) {
  SecureSession* session = updating_;
  AbortUpdate();
  SendResult(*session, status);
}

void OTARollbackGuard::Start() {
  esp_ota_img_states_t state;
  if (esp_ota_get_state_partition(esp_ota_get_running_partition(), &state) != ESP_OK ||
      state != ESP_OTA_IMG_PENDING_VERIFY) {
    return;
  }
  jll_info("OTA waiting to confirm that this new firmware works");
  deadline_ = TimeMicros() + timeout_;
  state_.store(State::kPending);
  if (xTaskCreatePinnedToCore(TimeoutTaskFunction, "JL_OTARollback", kRollbackTaskStackSize, /*parameters=*/this,
                              kRollbackTaskPriority, /*taskHandle=*/nullptr, kRollbackTaskCore) != pdPASS) {
    jll_error("OTA failed to create rollback task, so this firmware will only roll back if it gets rebooted");
  }
}

void OTARollbackGuard::RunLoop(bool rendered, bool networkConnected) {
  if (state_.load() != State::kPending) { return; }
  hasRendered_ = hasRendered_ || rendered;
  if (!networkConnected) {
    connectedSince_ = std::nullopt;
    return;
  }
  const Microseconds now = TimeMicros();
  if (!connectedSince_) { connectedSince_ = now; }
  if (!hasRendered_ || now - *connectedSince_ < connectedTime_) { return; }
  State expected = State::kPending;
  if (!state_.compare_exchange_strong(expected, State::kConfirmed)) { return; }
  const esp_err_t err = esp_ota_mark_app_valid_cancel_rollback();
  if (err != ESP_OK) {
    jll_error("OTA failed to mark this firmware valid with error %s", esp_err_to_name(err));
  } else {
    jll_info("OTA marked this firmware valid");
  }
}

// static
void OTARollbackGuard::TimeoutTaskFunction(void* parameters) {
  reinterpret_cast<OTARollbackGuard*>(parameters)->RunTimeoutTask();
  vTaskDelete(nullptr);
}

void OTARollbackGuard::RunTimeoutTask() {
  while (state_.load() == State::kPending && TimeMicros() < deadline_) { vTaskDelay(pdMS_TO_TICKS(1000)); }
  State expected = State::kPending;
  if (!state_.compare_exchange_strong(expected, State::kRollingBack)) { return; }
  jll_error("OTA rolling back because this firmware wasn't confirmed in time");
  // This only returns if it failed, such as when there's no other firmware to roll back to. This firmware then carries
  // on, and can still get confirmed later.
  const esp_err_t err = esp_ota_mark_app_invalid_rollback_and_reboot();
  jll_error("OTA failed to roll back with error %s", esp_err_to_name(err));
  state_.store(State::kPending);
}

}  // namespace jazzlights

#endif  // JL_OTA
